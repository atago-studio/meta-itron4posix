## conf/layer.conf
```bitbake
# We have a conf and classes directory, add to BBPATH
BBPATH .= ":${LAYERDIR}"

# We have recipes-* directories, add to BBFILES
BBFILES += "${LAYERDIR}/recipes-*/*/*.bb \
            ${LAYERDIR}/recipes-*/*/*.bbappend"

BBFILE_COLLECTIONS += "meta-itron4posix"
BBFILE_PATTERN_meta-itron4posix = "^${LAYERDIR}/"
BBFILE_PRIORITY_meta-itron4posix = "6"

LAYERDEPENDS_meta-itron4posix = "core"
LAYERSERIES_COMPAT_meta-itron4posix = "dunfell hardknott honister kirkstone"
```
